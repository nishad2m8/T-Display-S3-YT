#include <Arduino.h>
#include <TFT_eSPI.h>
#include "pin_config.h"

// Include your custom fonts
#include "Kenia50pt7b.h"
#include "Kranky50pt7b.h"
#include "IslandMoments30pt7b.h"
#include "Karantina35pt7b.h"
#include "Kablammo25pt7b.h"
#include "Orbitron30pt7b.h"

static const unsigned char PROGMEM image_bar_1_bits[] = {0x00,0x1f,0xe0,0x00,0x3f,0xc0,0x00,0x7f,0x80,0x00,0xff,0x00,0x01,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0x00,0x00};
static const unsigned char PROGMEM image_elements_1_bits[] = {0x00,0x00,0x60,0x30,0x00,0x00,0x70,0x70,0x00,0x00,0x30,0x70,0x00,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0x00,0x00};
static const unsigned char PROGMEM image_smiley_bits[] = {0x00,0x00,0x00,0x00,0x00,0x00,0x00,0x00,0x00,0x00,0x00,0x00,0x00,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0x00,0x00};

// Initialize the TFT screen
TFT_eSPI tft = TFT_eSPI();

#define BAR_WIDTH 19
#define BAR_HEIGHT 12
#define BAR_SPACING -8
#define START_X 199
#define START_Y 98

// Variables for counting up and down
int countUp = 0;
int countDown = 99;

// Symbol cycling
const char* symbols[] = {"~", "}", "|", "{", "[", "\\", "]", "^", "$", "#", "_"};
int symbolIndex = 0; // Index to keep track of the symbol

void drawBarIndicator(int count) {
    // Loop through 10 bars
    for (int i = 0; i < 10; i++) {
        // Calculate x-position of each bar
        int xPos = START_X + (BAR_WIDTH + BAR_SPACING) * i;

        // Determine the color of the bar
        uint16_t color = (count > i) ? 0xFFFF : 0x59CF;

        // Draw the bar
        tft.drawBitmap(xPos, START_Y, image_bar_1_bits, BAR_WIDTH, BAR_HEIGHT, color);
    }
}

void drawNumbersAndSymbols() {
    // Clear areas
    tft.fillRect(241, 117, 23, 48, 0x2849); // Clear area for "1"
    tft.fillRect(263, 117, 55, 48, 0x2849); // Clear area for "0"
    tft.fillRect(272, 34, 46, 53, 0x52BF);  // Clear area for "#"

    // Draw updated "#" symbol
    tft.setTextColor(0xFFEA);
    tft.setFreeFont(&Kablammo25pt7b);
    tft.drawString(symbols[symbolIndex], 276, 36);

    // Get the tens and units for the current countUp value
    int tens = countUp / 10;
    int units = countUp % 10;

    // Draw the tens digit
    tft.setTextColor(0x57EA);
    tft.setFreeFont(&Karantina35pt7b);
    tft.drawString(String(tens), 249, 106);

    // Draw the units digit
    tft.setTextColor(0xFFEA);
    tft.setFreeFont(&Orbitron30pt7b);
    tft.drawString(String(units), 267, 113);
}

// Function to draw static UI elements
void draw() {
    tft.fillRect(0, 0, 320, 170, 0x2849);
    tft.setTextColor(0xFAAA);
    tft.setTextSize(1);
    tft.setFreeFont(&Kenia50pt7b);
    tft.drawString("Custom", 5, 5);

    tft.drawBitmap(124, 18, image_elements_1_bits, 31, 34, 0x2869);
    tft.drawBitmap(86, 94, image_smiley_bits, 48, 25, 0xFFFF);

    tft.setTextColor(0xFFFF);
    tft.setFreeFont(&Kranky50pt7b);
    tft.drawString("Fonts", 6, 84);
    tft.setTextColor(0x57FF);
    tft.setFreeFont(&IslandMoments30pt7b);
    tft.drawString("Easy", 66, -4);

    tft.setTextColor(0xFABF);
    tft.setFreeFont(&Kablammo25pt7b);
    tft.drawString("#", 276, 36);
    tft.setTextColor(0x57EA);
    tft.setFreeFont(&Karantina35pt7b);
    tft.drawString("1", 249, 106);
    tft.setTextColor(0xFFEA);
    tft.setFreeFont(&Orbitron30pt7b);
    tft.drawString("0", 264, 113);
}

void setup() {
    pinMode(PIN_POWER_ON, OUTPUT);
    digitalWrite(PIN_POWER_ON, HIGH);

    // Start serial communication
    Serial.begin(115200);
    Serial.println("TFT Initialized...");
    
    tft.begin();
    tft.setRotation(3); // 1 or 3 for landscape
   
    tft.fillScreen(0x2849);
    
    draw();
    drawNumbersAndSymbols();
}

void loop() {
    // Update numbers for counting up and down
    countUp++;
    if (countUp > 99) countUp = 0;   // Reset countUp after reaching 99

    // Update symbol index
    symbolIndex++;
    if (symbolIndex >= sizeof(symbols) / sizeof(symbols[0])) {
        symbolIndex = 0;  // Loop back to the first symbol
    }

    // Redraw numbers, symbols, and bars
    drawNumbersAndSymbols();
    drawBarIndicator(countUp / 10); // Divide countUp by 10 to get active bar index

    delay(150);
}
